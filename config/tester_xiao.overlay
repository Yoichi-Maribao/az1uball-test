#include <dt-bindings/zmk/matrix_transform.h>
#include <input/processors.dtsi>
#include <dt-bindings/zmk/input_transform.h>

&xiao_i2c {
    status = "okay";
    clock-frequency = <I2C_BITRATE_FAST>;

    trackball: trackball@a {
        compatible = "palette,az1uball";
        reg = <0x0A>;
        status = "okay";
        default-mode = "mouse";
        sensitivity = "4x";
    };
};

/ {
    trackball_input_listener: trackball_input_listener {
        compatible = "zmk,input-listener";
        status = "okay";
        device = <&trackball>;
        input-processors = <&zip_xy_scaler 16 16>;
    };
};
